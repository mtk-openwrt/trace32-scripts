// SPDX-License-Identifier: BSD-3-Clause
// Copyright (c) 2021, MediaTek Inc. All rights reserved.
// Author: Weijie Gao <weijie.gao@mediatek.com>

// Set to 1 to enable chip reset
&ENRESET=1

// Set to 1 to enable DDR4 initialization
&DRAM_USE_DDR4=1

// Set to 1 to enable BGA chip initialization
&CHIP_IS_BGA=1

// Set DDR3 frequency (1866./2133.)
&DDR3_FREQ=2133.

// Set to 1 to enable DRAM debug log
&DRAM_DEBUG_LOG=0

// Flash device selection
&BL33="u-boot-spim-nand-nmbm.bin" // SPI-NAND on SPI-M with NMBM
//&BL33="u-boot-snfi-nand-nmbm.bin" // SPI-NAND on SNFI with NMBM
//&BL33="u-boot-spim-nor.bin" // SPI-NOR on SPI-M
//&BL33="u-boot-emmc.bin" // eMMC
//&BL33="u-boot-sd.bin" // SD

// Flash device selection (for NAND debugging purpose)
//&BL33="u-boot-spim-nand.bin" // SPI-NAND on SPI-M
//&BL33="u-boot-snfi-nand.bin" // SPI-NAND on SNFI

// System configuration
SYStem.RESet

IF &ENRESET==1
(
	SYStem.Option EnReset ON
	SYStem.Option WaitReset 100.ms
)
else
(
	SYStem.Option EnReset OFF
)

SYStem.Option ResBreak OFF
SYStem.JtagClock 10.MHz
SYStem.CPU CORTEXA53
SYStem.CONFIG MEMORYACCESSPORT 0
SYStem.CONFIG DEBUGACCESSPORT 1

// Multicore configuration
SYStem.CONFIG CoreNumber 2
CORE.ASSIGN 1.
SYStem.CONFIG COREBASE 0x8D410000 0x8D510000
SYStem.CONFIG CTIBASE 0x8D420000 0x8D520000

// Attach to the CPU
SYStem.Up

// Select core 0
CORE.Select 0

// Mask interrupts
SETUP.IMASKHLL ON
SETUP.IMASKASM ON

// Stop CPU execution
Break

// Delete all breakpoints
Break.Delete /ALL

// Disable Watchdog
Data.Set ASD:0x1001c000 %Long 0x22000000

// Switch to AArch64 mode
DO "~~~~/lib/reset_mode.cmm" 1

// Enable L2 shared cache
Data.Set ASD:0x104007f0 %Long 0x101

// Load and run BL2 to initialize DRAM
PRINT "Load and run BL2"
SYStem.Option TURBO ON
Data.LOAD.ELF "~~~~/recovery-files/bl2.elf"
SYStem.Option TURBO OFF

// Set DRAM configuration
Break mtk_mem_init_real /Onchip
Go
WAIT !State.Run()

Data.Set mt7981_use_ddr4 %Long &DRAM_USE_DDR4
Data.Set mt7981_bga_pkg %Long &CHIP_IS_BGA
Data.Set mt7981_ddr3_freq %Long &DDR3_FREQ
Data.Set mt7981_dram_debug %Long &DRAM_DEBUG_LOG
Data.Set mt7981_ddr_size_limit %Long 0

Break bl2_plat_handle_pre_image_load /Onchip
Go
WAIT !State.Run()

// Load BL31 and U-Boot
PRINT "Loading U-Boot"
SYStem.Option TURBO ON
Data.LOAD.Binary "~~~~/recovery-files/&BL33" 0x41e00000

PRINT "Loading BL31"
Data.LOAD.ELF "~~~~/recovery-files/bl31.elf"
SYStem.Option TURBO OFF

// Run recovery
Go

ENDDO
